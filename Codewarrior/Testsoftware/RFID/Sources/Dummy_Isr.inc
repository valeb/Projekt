;************************************************************************************************
;*                                                                                              *
;* DUMMY_ISR                                                                                    *
;* Wenn ein falscher Interrupt reinkommt...	                		                                *
;*                                                                                              *
;************************************************************************************************

Dummy_ISR1
         nop            ; Im Prinzip nix tun und sofort wieder raus aus dem Interrupt
         rti
         
         
Dummy_ISR2
         nop            ; Im Prinzip nix tun und sofort wieder raus aus dem Interrupt
         rti
         
Dummy_ISR3
         nop            ; Im Prinzip nix tun und sofort wieder raus aus dem Interrupt
         rti
         
Dummy_ISR4
         nop            ; Im Prinzip nix tun und sofort wieder raus aus dem Interrupt
         rti
                                    
Dummy_ISR5
         nop            ; Im Prinzip nix tun und sofort wieder raus aus dem Interrupt
         rti

Dummy_ISR6
         nop            ; Im Prinzip nix tun und sofort wieder raus aus dem Interrupt
         rti
                          
Dummy_ISR7
         nop            ; Im Prinzip nix tun und sofort wieder raus aus dem Interrupt
         rti

Dummy_ISR8
         nop            ; Im Prinzip nix tun und sofort wieder raus aus dem Interrupt
         rti
         
         
Dummy_ISR9
         nop            ; Im Prinzip nix tun und sofort wieder raus aus dem Interrupt
         rti
         
Dummy_ISR10
         nop            ; Im Prinzip nix tun und sofort wieder raus aus dem Interrupt
         rti

Dummy_ISR11
         nop            ; Im Prinzip nix tun und sofort wieder raus aus dem Interrupt
         rti
                                    
Dummy_ISR12
         nop            ; Im Prinzip nix tun und sofort wieder raus aus dem Interrupt
         rti

Dummy_ISR13
         nop            ; Im Prinzip nix tun und sofort wieder raus aus dem Interrupt
         rti
                          
Dummy_ISR14
         nop            ; Im Prinzip nix tun und sofort wieder raus aus dem Interrupt
         rti
              
Dummy_ISR15
         nop            ; Im Prinzip nix tun und sofort wieder raus aus dem Interrupt
         rti
         
         
Dummy_ISR16
         nop            ; Im Prinzip nix tun und sofort wieder raus aus dem Interrupt
         rti
         
Dummy_ISR17
         nop            ; Im Prinzip nix tun und sofort wieder raus aus dem Interrupt
         rti

Dummy_ISR18
         nop            ; Im Prinzip nix tun und sofort wieder raus aus dem Interrupt
         rti
                                    
Dummy_ISR19
         nop            ; Im Prinzip nix tun und sofort wieder raus aus dem Interrupt
         rti

Dummy_ISR20
         nop            ; Im Prinzip nix tun und sofort wieder raus aus dem Interrupt
         rti
                          
Dummy_ISR21
         nop            ; Im Prinzip nix tun und sofort wieder raus aus dem Interrupt
         rti
                                                              